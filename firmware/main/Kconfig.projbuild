## firmware/main/Kconfig.projbuild
```kconfig
choice TEE_HARDWARE_PROFILE
    prompt "TeeNet hardware profile"
    default TEE_BOARD_N16R8

config TEE_BOARD_N16R8
    bool "ESP32-S3 N16R8"

config TEE_BOARD_ATOMS3_LITE
    bool "M5Stack AtomS3 Lite + Tail485 (preferred)"
endchoice

config TEE_HTTP_CONTROL_TRIAL
    bool "Private HTTP pilot control trial (volatile opt-in, reference interlocks retained)"
    default n
    help
        Separate local trial. The Shelly current is excluded from the manual
        regulator, but retained as independent phase-zero and safety evidence.
        Arm explicitly through the authenticated trial API; expires without
        heartbeat. Never resumes after reboot. Not a released standalone mode.
```

## firmware/sdkconfig.defaults.16mb
```kconfig
# Configuration for ESP32-S3-N16R8 (16 MB)
CONFIG_ESPTOOLPY_FLASHSIZE_16MB=y
CONFIG_ESPTOOLPY_FLASHSIZE="16MB"
CONFIG_PARTITION_TABLE_CUSTOM=y
CONFIG_PARTITION_TABLE_CUSTOM_FILENAME="partitions_16mb.csv"

# Custom Macro für Code-Verzweigung
CONFIG_TEE_FLASH_SIZE_16MB=y
```
