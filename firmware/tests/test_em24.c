#include "em24_modbus.h"
#include "ems_core.h"
#include "shelly_modbus.h"
#include <assert.h>
#include <stdio.h>
#include <string.h>
#include <math.h>

static int64_t elapsed;
static int connect_cost,io_cost=1,corrupt,connects,closes;
static uint8_t request[12];
static unsigned expected_unit=7;
static bool sample_data;
static int64_t now_ms(void){return elapsed;}
static uint32_t esp_random(void){return 0x1234;}
static int tcp_connect_timeout(const char *host,uint16_t port,int timeout){
    assert(host && port==502 && timeout>0);connects++;elapsed+=connect_cost;return 42;
}
static int close(int fd){assert(fd==42);closes++;return 0;}
static bool socket_exact(int fd,uint8_t *data,size_t length,bool write,int64_t deadline){
    assert(fd==42);if(elapsed>=deadline)return false;
    elapsed+=io_cost;if(elapsed>deadline)return false;
    if(write){assert(length==12);memcpy(request,data,12);assert(data[6]==expected_unit && data[7]==4);return true;}
    unsigned count=((unsigned)request[10]<<8)|request[11];
    if(length==9){
        uint8_t header[]={request[0],request[1],0,0,0,(uint8_t)(count*2+3),request[6],4,(uint8_t)(count*2)};
        if(corrupt==1)header[0]^=1;
        if(corrupt==2)header[6]++;
        if(corrupt==3)header[7]=3;
        if(corrupt==4)header[8]--;
        if(corrupt==5)header[5]--;
        if(corrupt==6)header[2]=1;
        memcpy(data,header,9);return true;
    }
    if(corrupt==7)return false;
    assert(length==count*2);memset(data,0,length);
    if(sample_data){
        const uint8_t current[]={0x1f,0xa4,0,0,0x30,0x39,0,0,0xfd,0xe8,0,0};
        const uint8_t power[]={0xab,0x40,0,1};
        if(request[9]==EM24_CURRENT_START)memcpy(data,current,sizeof(current));
        else memcpy(data,power,sizeof(power));
    }
    return true;
}
#include "meter_tcp.inc"

static settings_t settings;
static bool wifi_online=true;
#define LOCK() do {} while(0)
#define UNLOCK() do {} while(0)
static bool read_shelly_modbus(const char *host,const char *type,shelly_modbus_reading_t *reading,int timeout){
    (void)host;(void)type;(void)reading;(void)timeout;
    assert(!"EM24 must not use the Shelly decoder");return false;
}
#include "wallbox_network.inc"

static void near(float a,float b){assert(fabsf(a-b)<.001f);}
int main(void){
    /* Independent wire bytes, not generated by the decoder: 8.1, 12.345,
       65 A and -1234.5 W, including two's complement and low-word order. */
    const uint8_t current[]={0x1f,0xa4,0,0,0x30,0x39,0,0,0xfd,0xe8,0,0};
    uint8_t power[]={0xcf,0xc7,0xff,0xff};
    em24_reading_t out={0};
    assert(em24_modbus_decode(current,12,power,4,&out));
    near(out.current_a[0],8.1f);near(out.current_a[1],12.345f);near(out.current_a[2],65);near(out.active_power_w,-1234.5f);
    const uint8_t import[]={0xab,0x40,0,1}; /* 109376 / 10 */
    assert(em24_modbus_decode(current,12,import,4,&out));near(out.active_power_w,10937.6f);
    em24_reading_t before=out;
    assert(!em24_modbus_decode(current,11,power,4,&out));assert(!memcmp(&before,&out,sizeof(out)));
    assert(!em24_modbus_decode(current,12,power,3,&out));assert(!em24_modbus_decode(NULL,12,power,4,&out));
    uint8_t broken[12];memcpy(broken,current,12);broken[2]=0xff;broken[3]=0xff;
    assert(!em24_modbus_decode(broken,12,power,4,&out));
    memcpy(broken,current,12);broken[2]=0x7f;broken[3]=0xff;
    assert(!em24_modbus_decode(broken,12,power,4,&out));
    power[2]=0x7f;power[3]=0xff;assert(!em24_modbus_decode(current,12,power,4,&out));
    uint8_t data[12];
    assert(modbus_tcp_read_input_unit("meter",7,0x000c,6,data,12,100));
    assert(request[8]==0 && request[9]==12 && request[11]==6);
    for(corrupt=1;corrupt<=7;corrupt++){elapsed=0;assert(!modbus_tcp_read_input_unit("meter",7,12,6,data,12,100));}
    corrupt=0;elapsed=0;connect_cost=100;
    assert(!modbus_tcp_read_input_unit("meter",7,12,6,data,12,100));
    assert(connects==closes);connect_cost=0;
    assert(!modbus_tcp_read_input_unit("meter",0,12,6,data,12,100));
    assert(!modbus_tcp_read_input_unit("meter",7,12,6,data,11,100));
    elapsed=0;expected_unit=1;assert(modbus_tcp_read_input("meter",12,6,data,12,100));
    expected_unit=7;elapsed=0;assert(read_em24_modbus("meter",7,&out,100));
    assert(request[9]==0x28 && request[11]==2);
    elapsed=0;io_cost=2;assert(!read_em24_modbus("meter",7,&out,9));
    settings_t s;settings_defaults(&s);strcpy(s.house_meter_type,"em24_tcp");
    s.zero_feed_enabled=true;s.grid_guard_enabled=true;s.house_address=7;
    assert(settings_valid(&s));s.house_meter_host[0]=0;assert(!settings_valid(&s));
    settings_defaults(&s);strcpy(s.wallbox_meter_type,"shelly_gen2");strcpy(s.wallbox_meter_host,"meter");
    s.wallbox_tx_pin=6;s.wallbox_rx_pin=5;
    assert(settings_shell_pin_available(&s,5,false));assert(settings_valid(&s));
    s.external_mode_input_enabled=true;assert(!settings_valid(&s));
    s.external_mode_input_enabled=false;strcpy(s.wallbox_meter_type,"xemex");assert(!settings_valid(&s));
    strcpy(s.wallbox_meter_type,"em24_tcp");s.xemex_address=7;
    assert(settings_valid(&s));assert(settings_shell_pin_available(&s,5,false));
    s.wallbox_meter_host[0]=0;assert(!settings_valid(&s));strcpy(s.wallbox_meter_host,"em24:1502");
    s.xemex_address=0;assert(!settings_valid(&s));s.xemex_address=248;assert(!settings_valid(&s));s.xemex_address=7;
    settings=s;settings.house_address=9;settings.charge_phases=3;
    elapsed=0;io_cost=1;sample_data=true;float feedback[3]={-1,-1,-1},watts=-1;
    assert(read_wallbox_network(feedback,&watts));
    near(feedback[0],8.1f);near(feedback[1],12.345f);near(feedback[2],65);near(watts,10937.6f);
    settings.charge_phases=1;
    assert(read_wallbox_network(feedback,&watts));
    near(feedback[0],8.1f);near(feedback[1],12.345f);near(feedback[2],65);near(watts,10937.6f);
    assert(wallbox_inactive_phase_current(&settings,feedback));
    corrupt=7;assert(!read_wallbox_network(feedback,&watts));near(watts,10937.6f);
    corrupt=0;wifi_online=false;int previous_connects=connects;
    assert(!read_wallbox_network(feedback,&watts));assert(connects==previous_connects);
    assert(connects==closes);
    puts("PASS: EM24 word order, import/export, overflow, MBAP identity, shared timeout, 3-phase guard and conditional GPIO5 reservation");
    return 0;
}
